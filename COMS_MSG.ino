void process_special_message (int face, int message_value, char message_char)
{
  cmd = "rain";
}

//int face_neighbors[FACES][6] = {
// ID            face          angle      time formed  certainty%  #of messages previous      
//"1-32" "1-6" "0-3"   "loop_counter_slow"  "1-100"       "1+"
////int face_neighbors[FACES][6]
//int n_cube_id       = 0;
//int n_face_id       = 1;
//int n_angle         = 2;
//int n_formed        = 3;
//int n_certainty     = 4;
//int n_num_messages  = 5;

void process_location_message(int face, int message_value, char message_char) 
{
  if(DEBUG){Serial.println("process_location_message");}
  if(DEBUG){print_out_ambient_buffer(face);}  //// ADD DECECTION OF ANGLE AND SIGNATURE WIP
  look_for_signature_in_ambient(face);
  y_counter = 8;
  int detected_face = convert_face_char_to_int(message_char);
  
  for(int i = 1; i < FACES; i++) // check to see if a cube with same ID already exists.. if so remove it from the list...
    {
       if(face_neighbors[i][n_cube_id] == message_value)
          {
            face_neighbors[i][n_cube_id]      = 0;
            face_neighbors[i][n_face_id]      = 0;
            face_neighbors[i][n_angle]        = 0;
            face_neighbors[i][n_num_messages] = 0;
            if(DEBUG){Serial.println("Removed Duplicate Entry...");}
          }
    }
  if(face_neighbors[face][n_cube_id] == message_value && face_neighbors[face][n_face_id] == detected_face)  {face_neighbors[face][n_num_messages]++;}
  else                                                                                                      {face_neighbors[face][n_num_messages] = 0;}  

  //appy_logic
  face_neighbors[face][n_cube_id] = message_value;  
  face_neighbors[face][n_face_id] = detected_face;
  face_neighbors[face][n_angle]   = 4;/////////////////////// WIP
  if(DEBUG){Serial.println("Leaving");print_out_connections();}
}
        
void process_hey_message     (int face, int message_value, char message_char)
{
  int faces_temp[7] = {0,1,1,1,1,1,1};
  for(int i = 1; i < FACES; i++) {if(face == i){faces_temp[i] = 0;}}
  
  send_ir_message_on_faces(faces_temp[1],faces_temp[2],faces_temp[3],faces_temp[4],faces_temp[5],faces_temp[6],hey_message);
  p_counter = 12;
  message_location_blink_counter[face] = 14;
  
}

//data.data[0] = 42
//data.data[1] = blockNumber
//data.data[2] = upFace (as an integer)
//
//[3] = Integer blockNumber of cube connected to face 1
//[4]  = Integer number of [3]’s face that this is connected to
//(For example, if side 1 of this cube is connected to cube 27’s 2nd face, then [3] = 27 and [4] = 2)
//
//[5] = Integer blockNumber of cube connected to face 2
//[6] = Integer number of [5]’s face that this is connected to
//
//[7]
//[8]   same for this cube’s 3rd face
//
//[9] & [10] for this cubes’s 4th face
//
//[11] & [12] for this cube’s 5th face
//
//[13] & [14] for this cube’s 6th face
//
//-- 
//Mateo Correa
//Sent with Airmail

void process_color_message   (int face, int message_value, char message_char)
{
  //edit_message_value(color_message, 'w'); send_ir_message_on_faces(1,1,1,1,1,1,color_message);rgbw();
  if(message_char == 'y' || message_char == 'r' || message_char == 'g' || message_char == 'b' || message_char == 'p' || message_char == 'w')
    {
      
      edit_message_value (temp_active_message, temp_message_value-1);
      edit_message_value (color_message, temp_message_value-1);
      edit_message_char (color_message, message_char);
      edit_message_char (temp_active_message, message_char);
      send_ir_message_on_faces (1,1,1,1,1,1,color_message);
      if(message_value > 50){for(int face = 1; face < ACTIVE_FACES; face++) {message_general_counter[face] = 2;}}
    }
       if(message_char == 'y')   {rgby();}
  else if(message_char == 'r')   {rgbr();}  
  else if(message_char == 'g')   {rgbg();}   
  else if(message_char == 'b')   {rgbb();}   
  else if(message_char == 'p')   {rgbp();}
  else if(message_char == 'w')   {rgbw();}
  
  Serial.println("DANCE!!!");
}

void process_motion_message  (int face, int message_value, char message_char)
{
  p_counter = 20;
}

//////////////////////////////////////////////////////////////////////////////////////////////
//////////////////////////////////////////////////////////////////////////////////////////////
//////////////////////////////////////////////////////////////////////////////////////////////
//////////////////////////////////////////////////////////////////////////////////////////////
//////////////////////////////////////////////////////////////////////////////////////////////
/////////////////////////////////////// HELPER FUNCTIONS//////////////////////////////////////
//////////////////////////////////////////////////////////////////////////////////////////////
//////////////////////////////////////////////////////////////////////////////////////////////
//////////////////////////////////////////////////////////////////////////////////////////////
//////////////////////////////////////////////////////////////////////////////////////////////
//////////////////////////////////////////////////////////////////////////////////////////////
//////////////////////////////////////////////////////////////////////////////////////////////
//////////////////////////////////////////////////////////////////////////////////////////////
//////////////////////////////////////////////////////////////////////////////////////////////
//////////////////////////////////////////////////////////////////////////////////////////////
//////////////////////////////////////////////////////////////////////////////////////////////
/////////////////////////////////////// HELPER FUNCTIONS//////////////////////////////////////
//////////////////////////////////////////////////////////////////////////////////////////////
//////////////////////////////////////////////////////////////////////////////////////////////
//////////////////////////////////////////////////////////////////////////////////////////////
//////////////////////////////////////////////////////////////////////////////////////////////
//////////////////////////////////////////////////////////////////////////////////////////////
//////////////////////////////////////////////////////////////////////////////////////////////
//////////////////////////////////////////////////////////////////////////////////////////////
//////////////////////////////////////////////////////////////////////////////////////////////
//////////////////////////////////////////////////////////////////////////////////////////////
//////////////////////////////////////////////////////////////////////////////////////////////
/////////////////////////////////////// HELPER FUNCTIONS//////////////////////////////////////
//////////////////////////////////////////////////////////////////////////////////////////////
//////////////////////////////////////////////////////////////////////////////////////////////
//////////////////////////////////////////////////////////////////////////////////////////////
//////////////////////////////////////////////////////////////////////////////////////////////
//////////////////////////////////////////////////////////////////////////////////////////////

int convert_face_char_to_int(char to_process)
{
  int other_face_detected = 0;
  
       if(to_process == 'a'){other_face_detected = 1;}
  else if(to_process == 'b'){other_face_detected = 2;}
  else if(to_process == 'c'){other_face_detected = 3;}
  else if(to_process == 'd'){other_face_detected = 4;}
  else if(to_process == 'e'){other_face_detected = 5;}
  else if(to_process == 'f'){other_face_detected = 6;}
  
  return other_face_detected;
}

